#include <Wire.h>
#include <LiquidCrystal_I2C.h>
#include <WiFi.h>
#include <WiFiClientSecure.h>
#include <HTTPClient.h>
#include <Preferences.h>
#include <WebServer.h>
#include <Update.h>
#include <ArduinoOTA.h>
#include <time.h>
#include <esp_system.h>
#include "mbedtls/sha256.h"

/*
  Plant Watering Smart V3 - Commercial Foundation - OTA
  V2 intentionally has NO tank sensor and NO flow sensor.
  Manual watering is time based. Fault reasons are generated by the ESP32
  and sent to Firebase as plant.faultReason. The dashboard does not guess
  or hard-code fault reasons.
*/

static const char *WIFI_SSID = "";
static const char *WIFI_PASSWORD = "";
static const char *FIREBASE_BASE_URL = "https://vernal-catfish-196407.firebaseio.com";
static const char *DEVICE_ROOT_PREFIX = "/plantMonitor/v3/devices/";
static const char *FIREBASE_AUTH = "";
static const char *OTA_PASSWORD = "";
static const char *FIRMWARE_VERSION = "Plant_Watering_Smart_V3_COMMERCIAL_1.0";
static const char *OTA_USER = "admin";
// Change this before the first flash on a new controller. The value is only used to initialize the NVS hash.
static const char *CONTROL_DEFAULT_PASSWORD = "CHANGE_ME_CONTROL_PASSWORD";
static const unsigned long CONTROL_SESSION_MS = 5UL*60UL*1000UL;
static const unsigned long CONTROL_CHALLENGE_MS = 60UL*1000UL;
static const unsigned long SECURITY_POLL_MS = 1000UL;

static const int NUM_PLANTS = 5;
static const int SENSOR_PINS[NUM_PLANTS] = {34,35,32,33,39};
static const int PUMP_PIN = 23;
static const int VALVE_PINS[NUM_PLANTS] = {14,25,26,27,13};
static const int RELAY_ON = LOW;
static const int RELAY_OFF = HIGH;
static const int LCD_ADDRESS = 0x27;
static const int SDA_PIN = 21;
static const int SCL_PIN = 22;

static const unsigned long BOOT_WATERING_GRACE_MS = 30000;
static const int REQUIRED_VALID_BOOT_SCANS = 5;
static const unsigned long SENSOR_SAMPLE_MS = 1000;
static const int SENSOR_SAMPLES = 10;
static const unsigned long LCD_UPDATE_MS = 1500;
static const unsigned long LCD_ROTATE_MS = 5000;
static const unsigned long STATUS_MS = 5000;
static const unsigned long COMMAND_MS = 3000;
static const unsigned long CONFIG_MS = 15000;
static const unsigned long TELEMETRY_MS = 5UL*60UL*1000UL;
static const unsigned long WIFI_RETRY_MS = 30000;
static const unsigned long VALVE_PREOPEN_MS = 300;
static const unsigned long VALVE_POSTPUMP_MS = 500;
static const unsigned long DEFAULT_SOAK_MS = 120000;
static const unsigned long DEFAULT_MIN_INTERVAL_MS = 60UL*60UL*1000UL;
static const unsigned long DEFAULT_MAX_BURST_MS = 15000;
static const unsigned long DEFAULT_MAX_SESSION_MS = 45000;
static const unsigned long DEFAULT_MAX_HOURLY_MS = 90000;
static const unsigned long DEFAULT_MAX_DAILY_MS = 180000;
static const unsigned long WATER_RESPONSE_TIMEOUT_MS = 180000;
static const unsigned long REMOTE_COMMAND_MAX_AGE_MS = 10UL*60UL*1000UL;
static const unsigned long REMOTE_COMMAND_FUTURE_SKEW_MS = 2UL*60UL*1000UL;
static const int MIN_MOISTURE_GAIN_PERCENT = 2;
static const int SENSOR_MIN_VALID = 80;
static const int SENSOR_MAX_VALID = 4095;
static const int SENSOR_CHANGE_DELTA = 4;
static const unsigned long SENSOR_STALE_MS = 6UL*60UL*60UL*1000UL;

enum PlantMode : uint8_t { MODE_AUTO=0, MODE_MANUAL=1, MODE_DISABLED=2 };
enum StopReason : uint8_t {
  STOP_NONE=0, STOP_TARGET_REACHED, STOP_BURST_COMPLETE, STOP_SESSION_LIMIT,
  STOP_HOURLY_LIMIT, STOP_DAILY_LIMIT, STOP_SENSOR_FAULT, STOP_EMERGENCY,
  STOP_MANUAL_COMPLETE, STOP_COMMAND_EXPIRED, STOP_WATER_RESPONSE
};

struct PlantConfig {
  String name; int airRaw; int wetRaw; int targetLow; int targetHigh;
  unsigned long burstMs; unsigned long soakMs; unsigned long minIntervalMs;
  unsigned long maxBurstMs; unsigned long maxSessionMs;
  unsigned long maxHourlyMs; unsigned long maxDailyMs; PlantMode mode;
};

struct PlantState {
  int raw=0; int moisture=0; int previousRaw=0; bool sensorFault=false; int validBootScans=0;
  unsigned long lastSensorChangeMs=0; bool watering=false; bool soaking=false; bool manualRequest=false;
  unsigned long manualRequestedMs=0; unsigned long burstStartMs=0; unsigned long sessionStartMs=0;
  unsigned long soakUntilMs=0; unsigned long lastWateredMs=0; unsigned long sessionPumpMs=0;
  unsigned long hourlyPumpMs=0; unsigned long dailyPumpMs=0; unsigned long hourWindowStartMs=0;
  unsigned long dayWindowStartMs=0; int moistureAtSessionStart=0; unsigned long responseDeadlineMs=0;
  bool waterResponseFault=false; unsigned long lastDeliveredMs=0; StopReason lastStopReason=STOP_NONE;
  char faultReason[96]="";
};

PlantConfig plants[NUM_PLANTS]={
  {"Aglaonema",3300,1150,35,60,3000,DEFAULT_SOAK_MS,DEFAULT_MIN_INTERVAL_MS,DEFAULT_MAX_BURST_MS,DEFAULT_MAX_SESSION_MS,DEFAULT_MAX_HOURLY_MS,DEFAULT_MAX_DAILY_MS,MODE_AUTO},
  {"Jade Plant",3400,1200,15,30,2500,DEFAULT_SOAK_MS,DEFAULT_MIN_INTERVAL_MS,DEFAULT_MAX_BURST_MS,DEFAULT_MAX_SESSION_MS,DEFAULT_MAX_HOURLY_MS,DEFAULT_MAX_DAILY_MS,MODE_AUTO},
  {"ZZ Plant",3400,1250,20,35,2500,DEFAULT_SOAK_MS,DEFAULT_MIN_INTERVAL_MS,DEFAULT_MAX_BURST_MS,DEFAULT_MAX_SESSION_MS,DEFAULT_MAX_HOURLY_MS,DEFAULT_MAX_DAILY_MS,MODE_AUTO},
  {"Monstera",2600,1200,35,45,3000,DEFAULT_SOAK_MS,DEFAULT_MIN_INTERVAL_MS,DEFAULT_MAX_BURST_MS,DEFAULT_MAX_SESSION_MS,DEFAULT_MAX_HOURLY_MS,DEFAULT_MAX_DAILY_MS,MODE_AUTO},
  {"Bamboo",3400,1250,10,40,3000,DEFAULT_SOAK_MS,DEFAULT_MIN_INTERVAL_MS,DEFAULT_MAX_BURST_MS,DEFAULT_MAX_SESSION_MS,DEFAULT_MAX_HOURLY_MS,DEFAULT_MAX_DAILY_MS,MODE_AUTO}
};

PlantState states[NUM_PLANTS];
LiquidCrystal_I2C lcd(LCD_ADDRESS,16,2);
WiFiClientSecure secureClient;
Preferences prefs;
WebServer server(80);
bool wifiConnected=false, systemReady=false, emergencyStop=false, otaInProgress=false, timeSynced=false;
int activePlant=-1, displayPlant=0;
unsigned long bootMs=0,lastSensorMs=0,lastLcdMs=0,lastRotateMs=0,lastStatusMs=0,lastCommandMs=0,lastConfigMs=0,lastTelemetryMs=0,lastWifiRetryMs=0;
String deviceIp="offline",lastCommandId="",lastConfigVersion="";\nString deviceId="",deviceSecret="",storedWifiSsid="",storedWifiPassword="";\nString provisioningApSsid="",provisioningApPassword="";\nbool provisioningMode=false;\nunsigned int wifiReconnectFailures=0;
String controlPasswordHash="",controlSalt="",authChallenge="",authChallengeId="",controlSessionToken="";
unsigned long authChallengeExpiresMs=0,controlSessionExpiresMs=0,lastSecurityMs=0,lastSecurityRequestMs=0;

String boolJson(bool v){return v?"true":"false";}
String modeText(PlantMode m){if(m==MODE_MANUAL)return "MANUAL";if(m==MODE_DISABLED)return "DISABLED";return "AUTO";}
PlantMode parseMode(String v){v.toUpperCase();if(v=="MANUAL")return MODE_MANUAL;if(v=="DISABLED")return MODE_DISABLED;return MODE_AUTO;}
String stopReasonText(StopReason r){
  switch(r){
    case STOP_TARGET_REACHED:return "Target reached"; case STOP_BURST_COMPLETE:return "Burst complete";
    case STOP_SESSION_LIMIT:return "Session limit"; case STOP_HOURLY_LIMIT:return "Hourly limit";
    case STOP_DAILY_LIMIT:return "Daily limit"; case STOP_SENSOR_FAULT:return "Sensor fault";
    case STOP_EMERGENCY:return "Emergency stop"; case STOP_MANUAL_COMPLETE:return "Manual complete";
    case STOP_COMMAND_EXPIRED:return "Command expired"; case STOP_WATER_RESPONSE:return "Water response fault";
    default:return "None";
  }
}
void setFaultReason(int i,const String &reason){reason.toCharArray(states[i].faultReason,sizeof(states[i].faultReason));}
void clearFaultReason(int i){states[i].faultReason[0]='\0';}
String safetyName(const String &v){String x=v;x.replace("\"","'");return x;}
String resetReasonText(){switch(esp_reset_reason()){case ESP_RST_POWERON:return "Power-on";case ESP_RST_EXT:return "External reset";case ESP_RST_SW:return "Software reset";case ESP_RST_PANIC:return "Panic";case ESP_RST_INT_WDT:return "Interrupt watchdog";case ESP_RST_TASK_WDT:return "Task watchdog";case ESP_RST_WDT:return "Watchdog";case ESP_RST_BROWNOUT:return "Brownout";default:return "Unknown";}}


String macHex(){
  uint64_t mac=ESP.getEfuseMac();
  char out[13];
  snprintf(out,sizeof(out),"%012llX",(unsigned long long)mac);
  return String(out);
}
void initDeviceIdentity(){
  String suffix=macHex();
  suffix=suffix.substring(max(0,(int)suffix.length()-6));
  deviceId="PLANT-"+suffix;
  prefs.begin("device",false);
  deviceSecret=prefs.getString("secret","");
  if(deviceSecret.length()<32){
    deviceSecret=randomHex(32);
    prefs.putString("secret",deviceSecret);
  }
  prefs.putString("deviceId",deviceId);
  prefs.end();
}
void loadStoredWifi(){
  prefs.begin("wifi",true);
  storedWifiSsid=prefs.getString("ssid","");
  storedWifiPassword=prefs.getString("pass","");
  prefs.end();
  if(!storedWifiSsid.length() && strlen(WIFI_SSID))storedWifiSsid=String(WIFI_SSID);
  if(!storedWifiPassword.length() && strlen(WIFI_SSID))storedWifiPassword=String(WIFI_PASSWORD);
}
void saveStoredWifi(const String &ssid,const String &password){
  prefs.begin("wifi",false);
  prefs.putString("ssid",ssid);
  prefs.putString("pass",password);
  prefs.end();
  storedWifiSsid=ssid;
  storedWifiPassword=password;
}
String htmlEscape(const String &v){
  String x=v;x.replace("&","&amp;");x.replace("<","&lt;");x.replace(">","&gt;");x.replace("\"","&quot;");return x;
}
String wifiAuthText(wifi_auth_mode_t t){
  switch(t){
    case WIFI_AUTH_OPEN:return "Open";
    case WIFI_AUTH_WEP:return "WEP";
    case WIFI_AUTH_WPA_PSK:return "WPA";
    case WIFI_AUTH_WPA2_PSK:return "WPA2";
    case WIFI_AUTH_WPA_WPA2_PSK:return "WPA/WPA2";
    case WIFI_AUTH_WPA3_PSK:return "WPA3";
    case WIFI_AUTH_WPA2_WPA3_PSK:return "WPA2/WPA3";
    default:return "Other";
  }
}
void startProvisioningAP(){
  provisioningMode=true;
  WiFi.mode(WIFI_AP_STA);
  provisioningApSsid="PlantCare-"+macHex().substring(6);
  provisioningApPassword="setup"+macHex().substring(6);
  if(provisioningApPassword.length()<8)provisioningApPassword+="1234";
  WiFi.softAP(provisioningApSsid.c_str(),provisioningApPassword.c_str());
  Serial.println("=== Wi-Fi provisioning mode ===");
  Serial.print("Device ID: ");Serial.println(deviceId);
  Serial.print("AP SSID: ");Serial.println(provisioningApSsid);
  Serial.print("AP password: ");Serial.println(provisioningApPassword);
  Serial.println("Open http://192.168.4.1/");
}
bool tryWifiCredentials(const String &ssid,const String &password,unsigned long timeoutMs=15000){
  if(!ssid.length())return false;
  WiFi.mode(provisioningMode?WIFI_AP_STA:WIFI_STA);
  WiFi.disconnect(false,true);
  delay(150);
  WiFi.begin(ssid.c_str(),password.c_str());
  unsigned long start=millis();
  while(WiFi.status()!=WL_CONNECTED && millis()-start<timeoutMs){
    server.handleClient();
    delay(100);
  }
  if(WiFi.status()!=WL_CONNECTED)return false;
  wifiConnected=true;
  deviceIp=WiFi.localIP().toString();
  wifiReconnectFailures=0;
  configTime(19800,0,"pool.ntp.org","time.nist.gov");
  for(int i=0;i<30;i++){time_t now=time(nullptr);if(now>1700000000){timeSynced=true;break;}delay(100);}
  if(provisioningMode){
    provisioningMode=false;
    WiFi.softAPdisconnect(true);
    WiFi.mode(WIFI_STA);
  }
  return true;
}
String provisioningPage(const String &message=""){
  String page="<!doctype html><html><head><meta name='viewport' content='width=device-width,initial-scale=1'><title>PlantCare Setup</title><style>body{font-family:Arial;max-width:620px;margin:30px auto;padding:20px}button,select,input{width:100%;padding:12px;margin:6px 0;box-sizing:border-box}button{cursor:pointer}.card{padding:16px;border:1px solid #ddd;border-radius:12px;margin-bottom:16px}.muted{color:#666}</style></head><body>";
  page+="<h1>PlantCare Wi-Fi Setup</h1><div class='card'><b>Device:</b> "+htmlEscape(deviceId)+"<br><span class='muted'>Select your home/office Wi-Fi and enter its password.</span></div>";
  if(message.length())page+="<div class='card'><b>"+htmlEscape(message)+"</b></div>";
  page+="<div class='card'><button onclick='scan()'>Scan Wi-Fi Networks</button><select id='ssid'><option value=''>Select Wi-Fi network</option></select><input id='pass' type='password' placeholder='Wi-Fi password'><button onclick='connect()'>Connect & Save</button></div>";
  page+="<div class='card'><b>Setup hotspot</b><br>SSID: "+htmlEscape(provisioningApSsid)+"<br>Password: "+htmlEscape(provisioningApPassword)+"<br>Open: http://192.168.4.1/</div>";
  page+="<script>async function scan(){let r=await fetch('/wifi/scan');let a=await r.json();let s=document.getElementById('ssid');s.innerHTML='<option value=\"\">Select Wi-Fi network</option>'+a.map(x=>'<option value=\"'+x.ssid.replace(/&/g,'&amp;').replace(/\"/g,'&quot;')+'\">'+x.ssid+' ('+x.rssi+' dBm, '+x.security+')</option>').join('')}async function connect(){let ssid=document.getElementById('ssid').value,pass=document.getElementById('pass').value;if(!ssid)return alert('Select a Wi-Fi network');let r=await fetch('/wifi/connect',{method:'POST',headers:{'Content-Type':'application/x-www-form-urlencoded'},body:'ssid='+encodeURIComponent(ssid)+'&password='+encodeURIComponent(pass)});alert(await r.text());}scan();</script></body></html>";
  return page;
}
void setupProvisioningRoutes(){
  server.on("/",HTTP_GET,[](){server.send(200,"text/html",provisioningPage());});
  server.on("/wifi",HTTP_GET,[](){server.send(200,"text/html",provisioningPage());});
  server.on("/wifi/scan",HTTP_GET,[](){
    int n=WiFi.scanNetworks(false,true);
    String out="[";
    for(int i=0;i<n;i++){
      if(i)out+=",";
      String ssid=WiFi.SSID(i);String safe=ssid;safe.replace("\\","\\\\");safe.replace("\"","\\\"");
      out+="{\"ssid\":\""+safe+"\",\"rssi\":"+String(WiFi.RSSI(i))+",\"security\":\""+wifiAuthText(WiFi.encryptionType(i))+"\"}";
    }
    out+="]";WiFi.scanDelete();server.send(200,"application/json",out);
  });
  server.on("/wifi/connect",HTTP_POST,[](){
    String ssid=server.arg("ssid"),password=server.arg("password");
    if(ssid.length()<1||ssid.length()>64||password.length()>63){server.send(400,"text/plain","Invalid Wi-Fi credentials.");return;}
    bool wasProvisioning=provisioningMode;
    if(tryWifiCredentials(ssid,password)){
      saveStoredWifi(ssid,password);
      server.send(200,"text/plain","Wi-Fi connected and saved. Restarting PlantCare...");
      delay(700);ESP.restart();return;
    }
    if(!wasProvisioning)provisioningMode=false;
    server.send(400,"text/plain","Could not connect. Existing Wi-Fi settings were kept.");
    if(wasProvisioning && WiFi.getMode()!=WIFI_AP_STA)startProvisioningAP();
  });
  server.on("/device",HTTP_GET,[](){
    String j="{\"deviceId\":\""+deviceId+"\",\"firmware\":\""+String(FIRMWARE_VERSION)+"\",\"provisioningMode\":"+boolJson(provisioningMode)+",\"wifiConfigured\":"+boolJson(storedWifiSsid.length()>0)+"}";
    server.send(200,"application/json",j);
  });
}
void connectWifi(){
  loadStoredWifi();
  if(!storedWifiSsid.length()){startProvisioningAP();return;}
  provisioningMode=false;
  WiFi.mode(WIFI_STA);
  WiFi.begin(storedWifiSsid.c_str(),storedWifiPassword.c_str());
  unsigned long start=millis();
  while(WiFi.status()!=WL_CONNECTED&&millis()-start<15000)delay(250);
  if(WiFi.status()==WL_CONNECTED){
    wifiConnected=true;wifiReconnectFailures=0;deviceIp=WiFi.localIP().toString();
    configTime(19800,0,"pool.ntp.org","time.nist.gov");
    for(int i=0;i<20;i++){time_t now=time(nullptr);if(now>1700000000){timeSynced=true;break;}delay(100);}
    return;
  }
  wifiConnected=false;deviceIp="offline";wifiReconnectFailures++;
  if(wifiReconnectFailures>=2)startProvisioningAP();
}
String firebaseUrl(const String &path){String u=String(FIREBASE_BASE_URL)+String(DEVICE_ROOT_PREFIX)+deviceId+path+".json";if(strlen(FIREBASE_AUTH)){u+="?auth=";u+=FIREBASE_AUTH;}return u;}
bool httpRequest(const String &method,const String &path,const String &json,String *response=nullptr){
  if(!wifiConnected||otaInProgress)return false;secureClient.setInsecure();HTTPClient http;if(!http.begin(secureClient,firebaseUrl(path)))return false;
  http.setTimeout(6000);if(method!="GET")http.addHeader("Content-Type","application/json");int code=-1;
  if(method=="GET")code=http.GET();else if(method=="PUT")code=http.PUT(json);else if(method=="POST")code=http.POST(json);
  if(response&&code>=200&&code<300)*response=http.getString();http.end();return code>=200&&code<300;
}
bool httpGet(const String &path,String &body){return httpRequest("GET",path,"",&body);}
bool httpPut(const String &path,const String &body){return httpRequest("PUT",path,body);}
bool httpPost(const String &path,const String &body){return httpRequest("POST",path,body);}

String jsonValue(const String &json,const String &key){String token="\""+key+"\"";int p=json.indexOf(token);if(p<0)return "";p=json.indexOf(':',p+token.length());if(p<0)return "";p++;while(p<(int)json.length()&&(json[p]==' '||json[p]=='\t'))p++;if(p>=json.length())return "";if(json[p]=='\"'){int e=json.indexOf('"',p+1);return e>p?json.substring(p+1,e):"";}int e=p;while(e<(int)json.length()&&json[e]!=','&&json[e]!='}')e++;return json.substring(p,e);}
long jsonLong(const String &json,const String &key,long fallback=0){String v=jsonValue(json,key);return v.length()?v.toInt():fallback;}

int moistureFromRaw(int i,int raw){int a=plants[i].airRaw,w=plants[i].wetRaw;if(a==w)return 0;float pct=(float)(a-raw)*100.0f/(float)(a-w);return constrain((int)roundf(pct),0,100);}
int readSensorRaw(int pin){long sum=0;for(int n=0;n<SENSOR_SAMPLES;n++){sum+=analogRead(pin);delay(3);}return (int)(sum/SENSOR_SAMPLES);}
void refreshRuntimeWindows(){unsigned long now=millis();for(int i=0;i<NUM_PLANTS;i++){if(states[i].hourWindowStartMs==0)states[i].hourWindowStartMs=now;if(states[i].dayWindowStartMs==0)states[i].dayWindowStartMs=now;if(now-states[i].hourWindowStartMs>=3600000UL){states[i].hourlyPumpMs=0;states[i].hourWindowStartMs=now;}if(now-states[i].dayWindowStartMs>=86400000UL){states[i].dailyPumpMs=0;states[i].dayWindowStartMs=now;}}}
void sampleSensors(){
  for(int i=0;i<NUM_PLANTS;i++){
    int raw=readSensorRaw(SENSOR_PINS[i]);PlantState &s=states[i];s.raw=raw;
    bool out=raw<SENSOR_MIN_VALID||raw>SENSOR_MAX_VALID;
    if(out){s.sensorFault=true;s.validBootScans=0;setFaultReason(i,"Sensor reading out of valid range");s.lastStopReason=STOP_SENSOR_FAULT;}
    else{
      if(abs(raw-s.previousRaw)>=SENSOR_CHANGE_DELTA){s.lastSensorChangeMs=millis();s.previousRaw=raw;}
      s.moisture=moistureFromRaw(i,raw);s.validBootScans++;
      if(s.validBootScans>=REQUIRED_VALID_BOOT_SCANS&&s.lastSensorChangeMs>0&&millis()-s.lastSensorChangeMs>=SENSOR_STALE_MS){s.sensorFault=true;setFaultReason(i,"Sensor reading has not changed for too long");s.lastStopReason=STOP_SENSOR_FAULT;}
      else if(!s.waterResponseFault){s.sensorFault=false;if(!s.faultReason[0])clearFaultReason(i);}
    }
  }
  lastSensorMs=millis();
}

void closeAllValves(){for(int i=0;i<NUM_PLANTS;i++)digitalWrite(VALVE_PINS[i],RELAY_OFF);}
void outputsOff(){digitalWrite(PUMP_PIN,RELAY_OFF);delay(40);closeAllValves();}
bool bootAllowsWatering(){return millis()-bootMs>=BOOT_WATERING_GRACE_MS&&systemReady;}
void setWaterFault(int i,const String &reason){states[i].waterResponseFault=true;setFaultReason(i,reason);states[i].lastStopReason=STOP_WATER_RESPONSE;}
void saveRuntime(int i){prefs.begin("runtime",false);prefs.putULong((String("h")+i).c_str(),states[i].hourlyPumpMs);prefs.putULong((String("d")+i).c_str(),states[i].dailyPumpMs);prefs.end();}
void loadRuntime(){prefs.begin("runtime",true);for(int i=0;i<NUM_PLANTS;i++){states[i].hourlyPumpMs=prefs.getULong((String("h")+i).c_str(),0);states[i].dailyPumpMs=prefs.getULong((String("d")+i).c_str(),0);}prefs.end();}
void saveEmergency(){prefs.begin("safety",false);prefs.putBool("estop",emergencyStop);prefs.end();}
void loadEmergency(){prefs.begin("safety",true);emergencyStop=prefs.getBool("estop",false);prefs.end();}

bool canStartPlant(int i,bool manual){if(i<0||i>=NUM_PLANTS)return false;PlantState&s=states[i];PlantConfig&c=plants[i];if(!bootAllowsWatering()||emergencyStop||s.sensorFault||s.waterResponseFault||c.mode==MODE_DISABLED)return false;if(!manual&&c.mode!=MODE_AUTO)return false;if(!manual&&s.moisture>=c.targetLow)return false;if(s.lastWateredMs&&millis()-s.lastWateredMs<c.minIntervalMs)return false;if(s.hourlyPumpMs>=c.maxHourlyMs||s.dailyPumpMs>=c.maxDailyMs)return false;return true;}
void startSession(int i,bool manual,unsigned long durationMs){if(!canStartPlant(i,manual))return;PlantState&s=states[i];activePlant=i;s.manualRequest=manual;s.manualRequestedMs=durationMs;s.sessionStartMs=millis();s.sessionPumpMs=0;s.moistureAtSessionStart=s.moisture;s.responseDeadlineMs=manual?0:millis()+WATER_RESPONSE_TIMEOUT_MS;s.soaking=false;s.watering=false;s.lastStopReason=STOP_NONE;clearFaultReason(i);}
void startBurst(int i){PlantState&s=states[i];digitalWrite(VALVE_PINS[i],RELAY_ON);delay(VALVE_PREOPEN_MS);digitalWrite(PUMP_PIN,RELAY_ON);s.watering=true;s.burstStartMs=millis();}
void finishSession(int i,StopReason reason){PlantState&s=states[i];digitalWrite(PUMP_PIN,RELAY_OFF);delay(VALVE_POSTPUMP_MS);closeAllValves();s.watering=false;s.soaking=false;s.lastWateredMs=millis();s.lastDeliveredMs=s.sessionPumpMs;s.lastStopReason=reason;if(reason!=STOP_WATER_RESPONSE&&!s.sensorFault)clearFaultReason(i);if(s.sessionPumpMs>0){s.hourlyPumpMs+=s.sessionPumpMs;s.dailyPumpMs+=s.sessionPumpMs;saveRuntime(i);}String completionTimestamp=historyTimestamp();unsigned long long completionEpochMs=historyEpochMs();String h="{\"plantIndex\":"+String(i)+",\"plantName\":\""+safetyName(plants[i].name)+"\",\"durationMs\":"+String(s.sessionPumpMs)+",\"reason\":\""+stopReasonText(reason)+"\",\"moistureStart\":"+String(s.moistureAtSessionStart)+",\"moistureEnd\":"+String(s.moisture)+",\"timestamp\":\""+completionTimestamp+"\",\"timestampEpochMs\":"+String(completionEpochMs)+"}";httpPost("/history/watering",h);s.manualRequest=false;s.manualRequestedMs=0;activePlant=-1;}
void stopBurst(int i,StopReason reason){PlantState&s=states[i];if(s.watering){s.sessionPumpMs+=millis()-s.burstStartMs;s.watering=false;digitalWrite(PUMP_PIN,RELAY_OFF);delay(VALVE_POSTPUMP_MS);closeAllValves();}s.soaking=false;if(reason==STOP_SENSOR_FAULT)s.sensorFault=true;s.lastStopReason=reason;if(reason!=STOP_WATER_RESPONSE&&!s.sensorFault)clearFaultReason(i);}
void evaluateWatering(){
  if(activePlant<0)return;int i=activePlant;PlantState&s=states[i];PlantConfig&c=plants[i];
  if(emergencyStop){stopBurst(i,STOP_EMERGENCY);activePlant=-1;return;}
  if(s.sensorFault){stopBurst(i,STOP_SENSOR_FAULT);activePlant=-1;return;}
  if(s.watering){unsigned long run=millis()-s.burstStartMs;if(run>=c.burstMs||s.sessionPumpMs+run>=c.maxSessionMs){s.sessionPumpMs+=run;s.watering=false;digitalWrite(PUMP_PIN,RELAY_OFF);delay(VALVE_POSTPUMP_MS);closeAllValves();s.soaking=true;s.soakUntilMs=millis()+c.soakMs;return;}if(s.manualRequest&&s.sessionPumpMs+run>=s.manualRequestedMs){s.sessionPumpMs+=run;s.watering=false;digitalWrite(PUMP_PIN,RELAY_OFF);delay(VALVE_POSTPUMP_MS);closeAllValves();finishSession(i,STOP_MANUAL_COMPLETE);return;}}
  if(s.soaking){if(millis()<s.soakUntilMs)return;s.soaking=false;if(s.manualRequest){finishSession(i,STOP_MANUAL_COMPLETE);return;}if(s.moisture>=c.targetHigh){finishSession(i,STOP_TARGET_REACHED);return;}if(s.responseDeadlineMs&&millis()>=s.responseDeadlineMs&&s.moisture-s.moistureAtSessionStart<MIN_MOISTURE_GAIN_PERCENT){setWaterFault(i,"Soil moisture did not increase after watering");finishSession(i,STOP_WATER_RESPONSE);return;}if(millis()-s.sessionStartMs>=c.maxSessionMs){finishSession(i,STOP_SESSION_LIMIT);return;}startBurst(i);return;}
  if(!s.watering&&!s.soaking)startBurst(i);
}

String plantConfigJson(int i){
  PlantConfig &c=plants[i];
  return "{\"name\":\""+safetyName(c.name)+"\",\"targetLow\":"+String(c.targetLow)+",\"targetHigh\":"+String(c.targetHigh)+",\"burstMs\":"+String(c.burstMs)+",\"soakSec\":"+String(c.soakMs/1000UL)+",\"minIntervalMin\":"+String(c.minIntervalMs/60000UL)+",\"mode\":\""+modeText(c.mode)+"\",\"airRaw\":"+String(c.airRaw)+",\"wetRaw\":"+String(c.wetRaw)+"}";
}
void savePlantConfigNvs(int i){
  prefs.begin("plantcfg",false);
  prefs.putString((String("p")+i).c_str(),plantConfigJson(i));
  prefs.putBool("init",true);
  prefs.end();
}
bool loadPlantConfigNvs(int i){
  prefs.begin("plantcfg",true);
  String b=prefs.getString((String("p")+i).c_str(),"");
  prefs.end();
  if(!b.length())return false;
  String n=jsonValue(b,"name");if(n.length())plants[i].name=n;
  plants[i].targetLow=constrain((int)jsonLong(b,"targetLow",plants[i].targetLow),0,95);
  plants[i].targetHigh=constrain((int)jsonLong(b,"targetHigh",plants[i].targetHigh),plants[i].targetLow+1,100);
  plants[i].burstMs=constrain((unsigned long)jsonLong(b,"burstMs",plants[i].burstMs),1000UL,plants[i].maxBurstMs);
  plants[i].soakMs=constrain((unsigned long)jsonLong(b,"soakSec",plants[i].soakMs/1000UL),10UL,1800UL)*1000UL;
  plants[i].minIntervalMs=constrain((unsigned long)jsonLong(b,"minIntervalMin",plants[i].minIntervalMs/60000UL),1UL,1440UL)*60000UL;
  String m=jsonValue(b,"mode");if(m.length())plants[i].mode=parseMode(m);
  plants[i].airRaw=(int)jsonLong(b,"airRaw",plants[i].airRaw);
  plants[i].wetRaw=(int)jsonLong(b,"wetRaw",plants[i].wetRaw);
  return true;
}
void updateConfig();
void loadOrMigratePlantConfig(){
  prefs.begin("plantcfg",true);
  bool initialized=prefs.getBool("init",false);
  prefs.end();
  if(initialized){
    for(int i=0;i<NUM_PLANTS;i++)loadPlantConfigNvs(i);
    return;
  }
  // One-time migration of the existing Firebase configuration into local NVS.
  updateConfig();
  for(int i=0;i<NUM_PLANTS;i++)savePlantConfigNvs(i);
}

void updateConfig(){for(int i=0;i<NUM_PLANTS;i++){String b;if(!httpGet(String("/config/plants/")+i,b)||!b.length()||b=="null")continue;String n=jsonValue(b,"name");if(n.length())plants[i].name=n;plants[i].targetLow=constrain((int)jsonLong(b,"targetLow",plants[i].targetLow),0,95);plants[i].targetHigh=constrain((int)jsonLong(b,"targetHigh",plants[i].targetHigh),plants[i].targetLow+1,100);plants[i].burstMs=constrain((unsigned long)jsonLong(b,"burstMs",plants[i].burstMs),1000UL,plants[i].maxBurstMs);plants[i].soakMs=constrain((unsigned long)jsonLong(b,"soakSec",plants[i].soakMs/1000UL),10UL,1800UL)*1000UL;plants[i].minIntervalMs=constrain((unsigned long)jsonLong(b,"minIntervalMin",plants[i].minIntervalMs/60000UL),1UL,1440UL)*60000UL;String m=jsonValue(b,"mode");if(m.length())plants[i].mode=parseMode(m);}}

String sha256Hex(const String &input){
  uint8_t digest[32];
  mbedtls_sha256_ret((const unsigned char*)input.c_str(), input.length(), digest, 0);
  char hex[65];
  for(int i=0;i<32;i++)sprintf(hex+(i*2),"%02x",digest[i]);
  hex[64]='\0';
  return String(hex);
}
String randomHex(size_t bytes){
  String out;
  uint8_t buf[32];
  if(bytes>sizeof(buf))bytes=sizeof(buf);
  esp_fill_random(buf,bytes);
  char hex[3];
  for(size_t i=0;i<bytes;i++){sprintf(hex,"%02x",buf[i]);out+=hex;}
  return out;
}bool constantTimeEqual(const String &a,const String &b){
  if(a.length()!=b.length())return false;
  uint8_t diff=0;
  for(size_t i=0;i<a.length();i++)diff|=(uint8_t)(a[i]^b[i]);
  return diff==0;
}
void initControlSecurity(){
  prefs.begin("security",false);
  controlSalt=prefs.getString("salt","");
  controlPasswordHash=prefs.getString("passHash","");
  if(!controlSalt.length()){controlSalt=randomHex(16);prefs.putString("salt",controlSalt);}
  if(controlPasswordHash.length()!=64){controlPasswordHash=sha256Hex(String(CONTROL_DEFAULT_PASSWORD)+controlSalt);prefs.putString("passHash",controlPasswordHash);}
  prefs.end();
  controlSessionToken="";controlSessionExpiresMs=0;authChallenge="";authChallengeId="";authChallengeExpiresMs=0;
}
bool controlSessionValid(const String &token){
  return token.length()>0 && constantTimeEqual(token,controlSessionToken) && (long)(millis()-controlSessionExpiresMs)<0;
}
void publishSecurityMeta(){
  if(!wifiConnected)return;
  String meta="{\"enabled\":true,\"algorithm\":\"SHA-256(password+salt) + SHA-256(hash+serverNonce+clientNonce)\",\"salt\":\""+controlSalt+"\",\"sessionSec\":"+String(CONTROL_SESSION_MS/1000UL)+"}";
  httpPut("/security/meta",meta);
}
void handleSecurity(){
  if(!wifiConnected)return;
  String req;
  if(!httpGet("/security/request",req)||req.length()<2||req=="null")return;
  String id=jsonValue(req,"id"),clientNonce=jsonValue(req,"clientNonce"),proof=jsonValue(req,"proof");
  if(!id.length()||!clientNonce.length())return;
  if(id!=authChallengeId && proof.length()==0){
    authChallengeId=id;authChallenge=randomHex(24);authChallengeExpiresMs=millis()+CONTROL_CHALLENGE_MS;
    String challenge="{\"id\":\""+safetyName(id)+"\",\"serverNonce\":\""+authChallenge+"\",\"expiresAtMs\":"+String(authChallengeExpiresMs)+"}";
    httpPut("/security/challenge",challenge);return;
  }
  if(id!=authChallengeId||!proof.length()||millis()>=authChallengeExpiresMs)return;
  String expected=sha256Hex(controlPasswordHash+authChallenge+clientNonce);bool ok=constantTimeEqual(proof,expected);
  String response="{\"id\":\""+safetyName(id)+"\",\"ok\":"+boolJson(ok);
  if(ok){controlSessionToken=randomHex(32);controlSessionExpiresMs=millis()+CONTROL_SESSION_MS;response+=",\"token\":\""+controlSessionToken+"\",\"expiresAtMs\":"+String(controlSessionExpiresMs);}
  else response+=",\"error\":\"Invalid password\"";
  response+="}";httpPut("/security/response",response);
  authChallenge="";authChallengeId="";authChallengeExpiresMs=0;
}

void handleCommand(){
  String b;if(!httpGet("/command",b)||b.length()<2||b=="null")return;String id=jsonValue(b,"id");if(!id.length()||id==lastCommandId)return;String action=jsonValue(b,"action");String authToken=jsonValue(b,"authToken");int p=(int)jsonLong(b,"plantIndex",-1);
  bool protectedAction=action=="emergency_stop"||action=="resume"||action=="set_mode"||action=="water_now"||action=="clear_fault"||action=="calibrate_dry"||action=="calibrate_wet"||action=="set_config"||action=="change_password";
  long issuedSec=jsonLong(b,"issuedAtEpochSec",0);
  if(issuedSec<=0){long legacyMs=jsonLong(b,"issuedAtEpochMs",0);if(legacyMs>0)issuedSec=legacyMs/1000L;}
  bool valid=true;
  if(action!="emergency_stop"&&timeSynced&&issuedSec>0){long nowSec=(long)time(nullptr);long ageSec=nowSec-issuedSec;if(ageSec<-(long)(REMOTE_COMMAND_FUTURE_SKEW_MS/1000UL)||ageSec>(long)(REMOTE_COMMAND_MAX_AGE_MS/1000UL))valid=false;}
  String result="ignored";
  if(protectedAction&&!controlSessionValid(authToken))result="unauthorized";
  else if(!valid)result="expired";else if(action=="emergency_stop"){emergencyStop=true;outputsOff();if(activePlant>=0)states[activePlant].lastStopReason=STOP_EMERGENCY;activePlant=-1;saveEmergency();result="stopped";}
  else if(action=="resume"){emergencyStop=false;outputsOff();saveEmergency();result="resumed";}
  else if(action=="set_mode"&&p>=0&&p<NUM_PLANTS){plants[p].mode=parseMode(jsonValue(b,"mode"));savePlantConfigNvs(p);httpPut(String("/config/plants/")+p,plantConfigJson(p));httpPut("/config/version",String(millis()));result="mode_set";}
  else if(action=="water_now"&&p>=0&&p<NUM_PLANTS&&!emergencyStop){unsigned long sec=constrain((unsigned long)jsonLong(b,"durationSec",5),1UL,plants[p].maxSessionMs/1000UL);states[p].manualRequest=true;states[p].manualRequestedMs=sec*1000UL;result=canStartPlant(p,true)?"queued":"blocked_by_safety";}
  else if(action=="clear_fault"&&p>=0&&p<NUM_PLANTS){states[p].waterResponseFault=false;if(states[p].sensorFault&&states[p].raw>=SENSOR_MIN_VALID&&states[p].raw<=SENSOR_MAX_VALID)states[p].sensorFault=false;if(!states[p].sensorFault){clearFaultReason(p);states[p].lastStopReason=STOP_NONE;}result="fault_cleared";}
  else if(action=="calibrate_dry"&&p>=0&&p<NUM_PLANTS){plants[p].airRaw=states[p].raw;savePlantConfigNvs(p);httpPut(String("/config/plants/")+p,plantConfigJson(p));result="dry_recorded";}
  else if(action=="calibrate_wet"&&p>=0&&p<NUM_PLANTS){plants[p].wetRaw=states[p].raw;savePlantConfigNvs(p);httpPut(String("/config/plants/")+p,plantConfigJson(p));result="wet_recorded";}
  else if(action=="set_config"&&p>=0&&p<NUM_PLANTS){String n=jsonValue(b,"name"),m=jsonValue(b,"mode");if(n.length())plants[p].name=n;plants[p].targetLow=constrain((int)jsonLong(b,"targetLow",plants[p].targetLow),0,95);plants[p].targetHigh=constrain((int)jsonLong(b,"targetHigh",plants[p].targetHigh),plants[p].targetLow+1,100);plants[p].burstMs=constrain((unsigned long)jsonLong(b,"burstMs",plants[p].burstMs),1000UL,plants[p].maxBurstMs);plants[p].soakMs=constrain((unsigned long)jsonLong(b,"soakSec",plants[p].soakMs/1000UL),10UL,1800UL)*1000UL;plants[p].minIntervalMs=constrain((unsigned long)jsonLong(b,"minIntervalMin",plants[p].minIntervalMs/60000UL),1UL,1440UL)*60000UL;if(m.length())plants[p].mode=parseMode(m);savePlantConfigNvs(p);httpPut(String("/config/plants/")+p,plantConfigJson(p));httpPut("/config/version",String(millis()));result="config_set";}
  else if(action=="change_password"){String newSalt=jsonValue(b,"newSalt"),newHash=jsonValue(b,"newHash");if(newSalt.length()>=16&&newSalt.length()<=64&&newHash.length()==64){prefs.begin("security",false);prefs.putString("salt",newSalt);prefs.putString("passHash",newHash);prefs.end();controlSalt=newSalt;controlPasswordHash=newHash;result="password_changed";}else result="invalid_password_data";}
  if(action=="water_now"&&p>=0&&p<NUM_PLANTS&&result=="queued")startSession(p,true,states[p].manualRequestedMs);
  String ack="{\"id\":\""+safetyName(id)+"\",\"action\":\""+safetyName(action)+"\",\"result\":\""+safetyName(result)+"\",\"handledAtMs\":"+String(millis())+"}";httpPut("/commandAck",ack);lastCommandId=id;
}

String plantJson(int i){PlantState&s=states[i];PlantConfig&c=plants[i];bool fault=s.sensorFault||s.waterResponseFault;String j="{";j+="\"name\":\""+safetyName(c.name)+"\",\"moisture\":"+String(s.moisture)+",\"raw\":"+String(s.raw)+",";j+="\"targetLow\":"+String(c.targetLow)+",\"targetHigh\":"+String(c.targetHigh)+",\"targetRange\":\""+String(c.targetLow)+"-"+String(c.targetHigh)+"%\",";j+="\"mode\":\""+modeText(c.mode)+"\",\"watering\":"+boolJson(s.watering)+",\"soaking\":"+boolJson(s.soaking)+",\"manualQueued\":"+boolJson(s.manualRequest)+",";j+="\"sensorFault\":"+boolJson(s.sensorFault)+",\"waterResponseFault\":"+boolJson(s.waterResponseFault)+",\"fault\":"+boolJson(fault)+",";j+="\"faultReason\":\""+safetyName(String(s.faultReason))+"\",\"lastStopReason\":\""+stopReasonText(s.lastStopReason)+"\",";j+="\"lastDeliveredMs\":"+String(s.lastDeliveredMs)+",\"hourlyPumpMs\":"+String(s.hourlyPumpMs)+",\"dailyPumpMs\":"+String(s.dailyPumpMs)+",\"burstMs\":"+String(c.burstMs)+",\"soakSec\":"+String(c.soakMs/1000UL)+",\"minIntervalMin\":"+String(c.minIntervalMs/60000UL)+"}";return j;}
String statusJson(){String j="{\"deviceId\":\""+deviceId+"\",\"firmware\":\""+String(FIRMWARE_VERSION)+"\",\"ota\":true,\"otaPort\":80,\"otaUser\":\""+String(OTA_USER)+"\",\"totalPlants\":"+String(NUM_PLANTS)+",\"systemReady\":"+boolJson(systemReady)+",\"wateringAllowed\":"+boolJson(bootAllowsWatering()&&!emergencyStop)+",\"emergencyStop\":"+boolJson(emergencyStop)+",\"activePlantIndex\":"+String(activePlant)+",\"ip\":\""+deviceIp+"\",\"wifiSsid\":\""+safetyName(storedWifiSsid)+"\",\"provisioningMode\":"+boolJson(provisioningMode)+",\"provisioningApSsid\":\""+safetyName(provisioningApSsid)+"\",\"wifiRssi\":"+String(wifiConnected?WiFi.RSSI():0)+",\"uptimeMin\":"+String(millis()/60000UL)+",\"updatedAtMs\":"+String(millis())+",\"heartbeatEpochSec\":"+String(timeSynced?(unsigned long)time(nullptr):0)+",\"resetReason\":\""+resetReasonText()+"\",\"timeSynced\":"+boolJson(timeSynced)+",\"plants\":[";for(int i=0;i<NUM_PLANTS;i++){if(i)j+=",";j+=plantJson(i);}j+="]}";return j;}
void publishStatus(){if(!wifiConnected)return;httpPut("/status",statusJson());lastStatusMs=millis();}
void publishTelemetry(){if(!wifiConnected)return;httpPost("/history/telemetry",statusJson());lastTelemetryMs=millis();}

String historyTimestamp(){if(!timeSynced)return "";time_t now=time(nullptr);struct tm tmNow;localtime_r(&now,&tmNow);char buf[24];strftime(buf,sizeof(buf),"%Y-%m-%d %H:%M:%S",&tmNow);return String(buf);}
unsigned long long historyEpochMs(){if(!timeSynced)return 0;return (unsigned long long)time(nullptr)*1000ULL;}

void refreshLcd(){lcd.clear();if(activePlant>=0){lcd.setCursor(0,0);lcd.print(plants[activePlant].name.substring(0,16));lcd.setCursor(0,1);lcd.print(states[activePlant].watering?"Watering":states[activePlant].soaking?"Soaking":"Running");return;}int i=displayPlant%NUM_PLANTS;lcd.setCursor(0,0);lcd.print(plants[i].name.substring(0,16));lcd.setCursor(0,1);if(states[i].sensorFault)lcd.print("Sensor fault");else if(states[i].waterResponseFault)lcd.print("Water response");else {lcd.print(states[i].moisture);lcd.print("% ");lcd.print(modeText(plants[i].mode));}}

void handleUpdateUpload(){
  HTTPUpload &up=server.upload();
  if(up.status==UPLOAD_FILE_START){
    if(OTA_PASSWORD[0]&&!server.authenticate(OTA_USER,OTA_PASSWORD)){return;}
    otaInProgress=true;outputsOff();
    Serial.printf("OTA upload started: %s\n",up.filename.c_str());
    if(!Update.begin(UPDATE_SIZE_UNKNOWN)){Update.printError(Serial);otaInProgress=false;outputsOff();}
  }else if(up.status==UPLOAD_FILE_WRITE){
    if(!otaInProgress)return;
    if(Update.write(up.buf,up.currentSize)!=up.currentSize){Update.printError(Serial);otaInProgress=false;}
  }else if(up.status==UPLOAD_FILE_END){
    if(!otaInProgress)return;
    if(Update.end(true))Serial.printf("OTA upload complete: %u bytes\n",up.totalSize);else {Update.printError(Serial);otaInProgress=false;outputsOff();}
  }else if(up.status==UPLOAD_FILE_ABORTED){Update.abort();otaInProgress=false;outputsOff();}
}

void setupOTA(){
  ArduinoOTA.setHostname(("plant-care-"+deviceId.substring(6)).c_str());
  if(OTA_PASSWORD[0])ArduinoOTA.setPassword(OTA_PASSWORD);
  ArduinoOTA.onStart([](){otaInProgress=true;outputsOff();});
  ArduinoOTA.onEnd([](){outputsOff();otaInProgress=false;});
  ArduinoOTA.begin();

  server.on("/update",HTTP_GET,[](){
    if(OTA_PASSWORD[0]&&!server.authenticate(OTA_USER,OTA_PASSWORD)){server.requestAuthentication();return;}
    String page="<!doctype html><html><head><meta charset='utf-8'><meta name='viewport' content='width=device-width,initial-scale=1'><title>Plant Life Care OTA</title></head><body><h2>Plant Life Care V3 OTA Update</h2><form method='POST' action='/update' enctype='multipart/form-data'><input type='file' name='firmware' accept='.bin' required><br><br><button type='submit'>Upload firmware</button></form></body></html>";
    server.send(200,"text/html",page);
  });
  server.on("/update",HTTP_POST,[](){
    if(OTA_PASSWORD[0]&&!server.authenticate(OTA_USER,OTA_PASSWORD)){server.requestAuthentication();return;}
    server.sendHeader("Connection","close");
    if(Update.hasError()){server.send(500,"text/plain","OTA update failed");otaInProgress=false;outputsOff();return;}
    server.send(200,"text/plain","OTA update successful. Rebooting...");
    delay(500);ESP.restart();
  },handleUpdateUpload);
  server.begin();
}
void connectWifi(){WiFi.mode(WIFI_STA);WiFi.begin(WIFI_SSID,WIFI_PASSWORD);unsigned long start=millis();while(WiFi.status()!=WL_CONNECTED&&millis()-start<15000)delay(250);wifiConnected=WiFi.status()==WL_CONNECTED;deviceIp=wifiConnected?WiFi.localIP().toString():"offline";if(wifiConnected){configTime(19800,0,"pool.ntp.org","time.nist.gov");for(int i=0;i<20;i++){time_t now=time(nullptr);if(now>1700000000){timeSynced=true;break;}delay(100);}}}

/* V3 commercial foundation: one firmware image can be flashed to many ESP32s.\n   Each device derives a stable product Device ID from the factory eFuse MAC,\n   stores Wi-Fi credentials in NVS, and exposes a local browser provisioning page\n   when no usable Wi-Fi is configured. The V2 controller logic remains unchanged.\n*/\nvoid setup(){
  Serial.begin(115200);bootMs=millis();initDeviceIdentity();for(int i=0;i<NUM_PLANTS;i++){pinMode(SENSOR_PINS[i],INPUT);pinMode(VALVE_PINS[i],OUTPUT);}pinMode(PUMP_PIN,OUTPUT);outputsOff();Wire.begin(SDA_PIN,SCL_PIN);lcd.init();lcd.backlight();lcd.clear();lcd.print("Plant Life Care");
  loadEmergency();loadRuntime();connectWifi();initControlSecurity();setupProvisioningRoutes();loadOrMigratePlantConfig();systemReady=true;setupOTA();sampleSensors();publishSecurityMeta();publishStatus();
}
void loop(){
  ArduinoOTA.handle();server.handleClient();refreshRuntimeWindows();
  if(WiFi.status()!=WL_CONNECTED){wifiConnected=false;if(millis()-lastWifiRetryMs>=WIFI_RETRY_MS){lastWifiRetryMs=millis();connectWifi();}}
  else {wifiConnected=true;deviceIp=WiFi.localIP().toString();}
  if(millis()-lastSensorMs>=SENSOR_SAMPLE_MS)sampleSensors();
  if(millis()-lastCommandMs>=COMMAND_MS){lastCommandMs=millis();handleCommand();}
  if(millis()-lastSecurityMs>=SECURITY_POLL_MS){lastSecurityMs=millis();handleSecurity();}
  if(millis()-lastSecurityRequestMs>=15000UL){lastSecurityRequestMs=millis();publishSecurityMeta();}
  if(activePlant<0){for(int i=0;i<NUM_PLANTS;i++){if(states[i].manualRequest&&canStartPlant(i,true)){startSession(i,true,states[i].manualRequestedMs);break;}if(plants[i].mode==MODE_AUTO&&canStartPlant(i,false)&&states[i].moisture<=plants[i].targetLow){startSession(i,false,0);break;}}}
  evaluateWatering();
  if(millis()-lastStatusMs>=STATUS_MS)publishStatus();
  if(millis()-lastTelemetryMs>=TELEMETRY_MS)publishTelemetry();
  if(millis()-lastLcdMs>=LCD_UPDATE_MS){lastLcdMs=millis();refreshLcd();}
  if(millis()-lastRotateMs>=LCD_ROTATE_MS){lastRotateMs=millis();displayPlant=(displayPlant+1)%NUM_PLANTS;}
}